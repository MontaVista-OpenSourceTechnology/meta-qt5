## conf/layer.conf
```bitbake
BBPATH ?= ""
# We have a conf and classes directory, add to BBPATH
BBPATH := "${LAYERDIR}:${BBPATH}"

# We have an images and various recipe-* directories, add to BBFILES
BBFILES += " ${LAYERDIR}/recipes/*/*.bb ${LAYERDIR}/recipes*/*/*.bb"
BBFILES += " ${LAYERDIR}/recipes/*/*.bbappend ${LAYERDIR}/recipes*/*/*.bbappend"
	
BBFILE_COLLECTIONS += "graphics-montavista"
BBFILE_PATTERN_graphics-montavista := "^${LAYERDIR}/"
BBFILE_PRIORITY_graphics-montavista = "6"

LAYERSERIES_COMPAT_graphics-montavista = "warrior"
CGX_PROFILES_mvista-cgx += "graphics"

INHERIT += "sanity-meta-montavista-graphics"
```
